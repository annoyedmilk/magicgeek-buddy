// Drawing primitives + 8x8 font, composing into the banded RAM
// framebuffer. Pixels go directly into the band buffer one at a time;
// no per-glyph stack scratch buffer (an earlier direct-to-SPI version
// allocated one and blew the stack at scale 3, corrupting the scheduler
// task list).
#include "gfx.h"
#include "display.h"
#include "framebuffer.h"
#include <string.h>

static const uint8_t font_8x8[][8] = {
    {0x00,0x00,0x00,0x00,0x00,0x00,0x00,0x00}, // ' ' 32
    {0x18,0x18,0x18,0x18,0x18,0x00,0x18,0x00}, // !
    {0x6C,0x6C,0x24,0x00,0x00,0x00,0x00,0x00}, // "
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    {0x76,0xDC,0x00,0x00,0x00,0x00,0x00,0x00}, // ~
};

void gfx_fill_rect(int x, int y, int w, int h, uint16_t color)
{
    fb_fill_rect(x, y, w, h, color);
}

// Glyph cell, scale-aware. Background pixels are written too so the cell
// fully overpaints whatever was there - same semantics as the old direct
// version, but composing into RAM. The framebuffer skips out-of-band writes,
// so the same call works correctly across both band passes.
void gfx_char(int x, int y, char c, uint16_t fg, uint16_t bg, int scale)
{
    if (c < 32 || c > 126) c = '?';
    const uint8_t *g = font_8x8[c - 32];
    if (scale < 1) scale = 1;

    if (scale == 1) {
        for (int row = 0; row < 8; row++) {
            uint8_t bits = g[row];
            for (int col = 0; col < 8; col++) {
                fb_set_px(x + col, y + row, (bits & (0x80 >> col)) ? fg : bg);
            }
        }
        return;
    }
    for (int row = 0; row < 8; row++) {
        uint8_t bits = g[row];
        for (int col = 0; col < 8; col++) {
            uint16_t px = (bits & (0x80 >> col)) ? fg : bg;
            fb_fill_rect(x + col * scale, y + row * scale, scale, scale, px);
        }
    }
}

int gfx_text(int x, int y, const char *s, uint16_t fg, uint16_t bg, int scale)
{
    if (scale < 1) scale = 1;
    int cw = 8 * scale;
    for (const char *p = s; *p; p++) {
        gfx_char(x, y, *p, fg, bg, scale);
        x += cw;
    }
    return x;
}

void gfx_text_center(int y, const char *s, uint16_t fg, uint16_t bg, int scale)
{
    if (scale < 1) scale = 1;
    int w = (int)strlen(s) * 8 * scale;
    int x = (DISPLAY_WIDTH - w) / 2;
    if (x < 0) x = 0;
    gfx_text(x, y, s, fg, bg, scale);
}
